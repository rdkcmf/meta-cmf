## conf/distro/include/rdkcmf.inc
```bitbake
BBMASK .= "|meta-rdk/recipes-extended/jquery/"

MAINTAINER = "RDK CMF Team <support@rdkcentral.com>"

PREFERRED_VERSION_breakpad = "git"
PREFERRED_PROVIDER_curl ?= "curl"

# Revert meta-rdk/+/73763 RDKTV-17032: Build failure due to compiler out of memory
# It is causing race condition issues in build
PARALLEL_MAKE_remove = " -l ${@int(os.sysconf(os.sysconf_names['SC_NPROCESSORS_ONLN'])) * 150/100}"
```

## conf/layer.conf
```bitbake
BBPATH .= ":${LAYERDIR}"

BBFILES += "\
            ${LAYERDIR}/recipes-*/*/*.bb \
            ${LAYERDIR}/recipes-*/*/*/*.bb \
            ${LAYERDIR}/recipes-*/*/*.bbappend \
            ${LAYERDIR}/recipes-*/*/*/*.bbappend \
           "

BBFILE_COLLECTIONS += "cmf"
BBFILE_PATTERN_cmf := "^${LAYERDIR}/"
#BBFILE_PRIORITY_cmf = "25"

LAYERSERIES_COMPAT_cmf = "dunfell"

# Additional license directories.
LICENSE_PATH += "${LAYERDIR}/licenses"

LAYERDEPENDS_cmf = "rdk"

RDK_ROOT_PATH = "${LAYERDIR}/.."

require conf/distro/include/rdkcmf.inc
require conf/distro/include/rdk-external-src.inc
require conf/distro/include/rdk-versions.inc

PREFERRED_PROVIDER_virtual/samplemedia ?= "linaro-samplemedia"
PREFERRED_VERSION_lighttpd = "1.4.39"
PREFERRED_VERSION_xfsprogs_morty = "4.8.0"

# gmp 4.2.1 is the last version released as LGPLv2
# nettle 2.7.1 is the last version released as LGPLv2
# gnutls 3.3.x is the last branch which supports nettle 2.7.1
PREFERRED_VERSION_gmp_morty = "4.2.1"
PREFERRED_VERSION_nettle_morty = "2.7.1"
PREFERRED_VERSION_gnutls_morty = "3.3.%"

#Temporary bbmasks for components that have not been opensourced yet
BBMASK .= "|meta-rdk-video/recipes-extended/clnl/"
BBMASK .= "|meta-rdk-broadband/recipes-ccsp/ccsp/ccsp-one-wifi.bb"
BBMASK .= "|meta-rdk-broadband/recipes-ccsp/ccsp/ccsp-dhcp-mgr.bb"

# There are two copies of bluez in openembedded-core and meta-rdk-ext, 
# masking the one in openembedded-core
BBMASK .= "|meta/recipes-connectivity/bluez5/"

# The breakpad recipe in meta-cmf is for morty only (git instead of svn version)
# Dunfell should use the default breakpad recipe in meta-openembedded
BBMASK_append_dunfell .= "|meta-cmf/recipes-devtools/breakpad/"

# The linux-libc-headers recipe in meta-rdk-ext is for a specific Comcast platform
# and not applicable to CMF platforms
BBMASK_append_morty .= "|meta-rdk-ext/recipes-kernel/linux/linux-libc-headers_3.14.bb"

DISTRO_FEATURES_append_arm = " ld-is-gold"
DISTRO_FEATURES_append_x86 = " ld-is-gold"
DISTRO_FEATURES_append_dunfell = " dunfell"
DISTRO_FEATURES_append_dunfell = " virtualization"
DISTRO_FEATURES_append_dunfell = " ssl-1.1.1"

PREFERRED_VERSION_xfsprogs_morty = "4.8.0"
PREFERRED_VERSION_xfsprogs_dunfell = "5.2.1"
```
